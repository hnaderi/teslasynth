## sdkconfig.defaults.esp32c3
```kconfig
CONFIG_ESP_DEFAULT_CPU_FREQ_MHZ_160=y
CONFIG_ESP_DEFAULT_CPU_FREQ_MHZ=160

# Teslasynth
CONFIG_TESLASYNTH_OUTPUT_COUNT=2
CONFIG_TESLASYNTH_OUTPUT_GPIO_PIN1=1
CONFIG_TESLASYNTH_OUTPUT_GPIO_PIN2=3
```
