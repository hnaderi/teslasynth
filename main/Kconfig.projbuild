## main/Kconfig.projbuild
```kconfig
menu "Teslasynth"

menu "Outputs"

menu "LED"

config TESLASYNTH_OUTPUT_GPIO_LED
    int "GPIO Pin for Signal LED"
    default -1
    range -1 39

config TESLASYNTH_OUTPUT_GPIO_LED_ACTIVE_LOW
    bool "Is active low?"
    default "n"

endmenu


config TESLASYNTH_OUTPUT_COUNT
    int "Number of outputs"
    range 1 4
    default 1

config TESLASYNTH_OUTPUT_GPIO_PIN1
    int "GPIO Pin for output #1"
    default 12
    range 0 39
    depends on TESLASYNTH_OUTPUT_COUNT >= 1

config TESLASYNTH_OUTPUT_GPIO_PIN2
    int "GPIO Pin for output #2"
    default 13
    range 0 39
    depends on TESLASYNTH_OUTPUT_COUNT >= 2

config TESLASYNTH_OUTPUT_GPIO_PIN3
    int "GPIO Pin for output #3"
    default 14
    range 0 39
    depends on TESLASYNTH_OUTPUT_COUNT >= 3

config TESLASYNTH_OUTPUT_GPIO_PIN4
    int "GPIO Pin for output #4"
    default 27
    range 0 39
    depends on TESLASYNTH_OUTPUT_COUNT >= 4

endmenu

menu "Device"

config TESLASYNTH_DEVICE_NAME
    string "Advertised Device Name"
    default "Teslasynth"

config TESLASYNTH_WIFI_PASSWORD
        string "WiFi Password"
        default "Wardenclyffe1891!"
        help
            WiFi password 

config TESLASYNTH_WIFI_CHANNEL
        int "WiFi Channel"
        range 1 13
        default 1
        help
            WiFi channel (network channel)

endmenu

menu "Synth"

config CONFIG_MAX_NOTES
    int "Max notes"
    default 4
    range 1 8
    help
        This is the maximum size possible for notes.
        You can configure max concurrent notes up to this value.

config CONFIG_DEFAULT_MAX_DUTY
    int "Default max duty for all channels"
    default 10
    range 1 100
    help
        This is the maximum size possible for notes.
        You can configure max concurrent notes up to this value.
endmenu

menu "Log"

config TESLASYNTH_DEBUG
    bool "Enable debug logs"
    default "n"
endmenu

endmenu
```

## sdkconfig.defaults
```kconfig
# Teslasynth
CONFIG_TESLASYNTH_OUTPUT_COUNT=4
CONFIG_TESLASYNTH_DEVICE_NAME="Teslasynth"


# Bluetooth
CONFIG_BT_ENABLED=y
CONFIG_BT_NIMBLE_ENABLED=y
CONFIG_BT_NIMBLE_SVC_GAP_DEVICE_NAME="Teslasynth"
CONFIG_NIMBLE_SVC_GAP_DEVICE_NAME="Teslasynth"

# Enable security for BLE MIDI — Apple BLE MIDI spec requires Security Mode 1,
# Level 2 (unauthenticated pairing with encryption, i.e. Just Works).
# Without this, Linux/bluez disconnects with auth failure when it tries to
# encrypt the link before enabling notifications on the MIDI characteristic.
CONFIG_BT_NIMBLE_SECURITY_ENABLE=y
CONFIG_BT_NIMBLE_SM_LEGACY=y
CONFIG_BT_NIMBLE_SM_SC=y

# Disable host privacy — a fixed embedded device has no reason to hide
# its address with a Resolvable Private Address.
CONFIG_BT_NIMBLE_HS_PVCY=n

# CONFIG_BT_NIMBLE_ROLE_CENTRAL is not set
# CONFIG_BT_NIMBLE_ROLE_OBSERVER is not set
# CONFIG_NIMBLE_ROLE_CENTRAL is not set
# CONFIG_NIMBLE_ROLE_OBSERVER is not set

CONFIG_BT_NIMBLE_MAX_CONNECTIONS=1
CONFIG_BT_NIMBLE_RECONFIG_MTU=n
CONFIG_BTDM_CTRL_BLE_MAX_CONN=1
CONFIG_BTDM_CTRL_BLE_MAX_CONN_EFF=1
CONFIG_BTDM_CONTROLLER_BLE_MAX_CONN=1
CONFIG_BTDM_CONTROLLER_BLE_MAX_CONN_EFF=1

# Kernel
CONFIG_FREERTOS_HZ=1000

# Task watchdog — output task subscribes to this; panic resets the MCU on hang
CONFIG_ESP_TASK_WDT_EN=y
CONFIG_ESP_TASK_WDT_INIT=y
CONFIG_ESP_TASK_WDT_PANIC=y
CONFIG_ESP_TASK_WDT_TIMEOUT_S=1

# Partition table
CONFIG_PARTITION_TABLE_CUSTOM=y
CONFIG_PARTITION_TABLE_FILENAME="partitions.csv"

# Flash size
CONFIG_ESPTOOLPY_FLASHSIZE_4MB=y

# CONFIG_ESP32_WIFI_RX_IRAM_OPT is not set
# CONFIG_ESP_WIFI_RX_IRAM_OPT is not set
# CONFIG_RMT_RX_ISR_HANDLER_IN_IRAM is not set
# CONFIG_OPTIMIZATION_LEVEL_DEBUG is not set
# CONFIG_COMPILER_OPTIMIZATION_LEVEL_DEBUG is not set
# CONFIG_COMPILER_OPTIMIZATION_DEFAULT is not set

CONFIG_BOOTLOADER_COMPILER_OPTIMIZATION_PERF=y
CONFIG_COMPILER_OPTIMIZATION_PERF=y
```

## sdkconfig.defaults.esp32
```kconfig
CONFIG_ESP_DEFAULT_CPU_FREQ_MHZ_240=y
CONFIG_ESP_DEFAULT_CPU_FREQ_MHZ=240
CONFIG_ESP32_DEFAULT_CPU_FREQ_240=y
CONFIG_ESP32_DEFAULT_CPU_FREQ_MHZ=240

CONFIG_TESLASYNTH_OUTPUT_GPIO_PIN1=12
CONFIG_TESLASYNTH_OUTPUT_GPIO_PIN2=13
CONFIG_TESLASYNTH_OUTPUT_GPIO_PIN3=14
CONFIG_TESLASYNTH_OUTPUT_GPIO_PIN4=27
```

## sdkconfig.defaults.esp32s2
```kconfig
CONFIG_ESP_DEFAULT_CPU_FREQ_MHZ_240=y
CONFIG_ESP_DEFAULT_CPU_FREQ_MHZ=240
CONFIG_ESP32S2_DEFAULT_CPU_FREQ_240=y
CONFIG_ESP32S2_DEFAULT_CPU_FREQ_MHZ=240

CONFIG_TINYUSB_MIDI_COUNT=1

CONFIG_TESLASYNTH_OUTPUT_GPIO_PIN1=1
CONFIG_TESLASYNTH_OUTPUT_GPIO_PIN2=2
CONFIG_TESLASYNTH_OUTPUT_GPIO_PIN3=3
CONFIG_TESLASYNTH_OUTPUT_GPIO_PIN4=4

CONFIG_ESP_CONSOLE_UART_CUSTOM=y
CONFIG_ESP_CONSOLE_UART=y
CONFIG_ESP_CONSOLE_UART_CUSTOM_NUM_0=y
CONFIG_ESP_CONSOLE_UART_NUM=0
CONFIG_ESP_CONSOLE_ROM_SERIAL_PORT_NUM=0
CONFIG_ESP_CONSOLE_UART_TX_GPIO=37
CONFIG_ESP_CONSOLE_UART_RX_GPIO=38
CONFIG_ESP_CONSOLE_UART_BAUDRATE=115200

# WPA3 SAE password-element derivation hogs CPU 0 long enough to starve
# IDLE on this single-core target and trip the 1 s TWDT. Drop SAE on S2
# only; the AP falls back to WPA2-PSK via the #ifdef in wifi.cpp.
CONFIG_ESP_WIFI_SOFTAP_SAE_SUPPORT=n
```

## sdkconfig.defaults.esp32s3
```kconfig
CONFIG_ESP_DEFAULT_CPU_FREQ_MHZ_240=y
CONFIG_ESP_DEFAULT_CPU_FREQ_MHZ=240
CONFIG_ESP32S3_DEFAULT_CPU_FREQ_240=y
CONFIG_ESP32S3_DEFAULT_CPU_FREQ_MHZ=240

CONFIG_TINYUSB_MIDI_COUNT=1

CONFIG_TESLASYNTH_OUTPUT_GPIO_PIN1=4
CONFIG_TESLASYNTH_OUTPUT_GPIO_PIN2=5
CONFIG_TESLASYNTH_OUTPUT_GPIO_PIN3=6
CONFIG_TESLASYNTH_OUTPUT_GPIO_PIN4=7
```

## src/Kconfig.projbuild
```kconfig
menu "Teslasynth"

menu "Outputs"

menu "LED"

config TESLASYNTH_OUTPUT_GPIO_LED
    int "GPIO Pin for Signal LED"
    default -1
    range -1 39

config TESLASYNTH_OUTPUT_GPIO_LED_ACTIVE_LOW
    bool "Is active low?"
    default "n"

endmenu


config TESLASYNTH_OUTPUT_COUNT
    int "Number of outputs"
    range 1 4
    default 1

config TESLASYNTH_OUTPUT_GPIO_PIN1
    int "GPIO Pin for output #1"
    default 12
    range 0 39
    depends on TESLASYNTH_OUTPUT_COUNT >= 1

config TESLASYNTH_OUTPUT_GPIO_PIN2
    int "GPIO Pin for output #2"
    default 13
    range 0 39
    depends on TESLASYNTH_OUTPUT_COUNT >= 2

config TESLASYNTH_OUTPUT_GPIO_PIN3
    int "GPIO Pin for output #3"
    default 14
    range 0 39
    depends on TESLASYNTH_OUTPUT_COUNT >= 3

config TESLASYNTH_OUTPUT_GPIO_PIN4
    int "GPIO Pin for output #4"
    default 27
    range 0 39
    depends on TESLASYNTH_OUTPUT_COUNT >= 4

endmenu

menu "Device"

config TESLASYNTH_DEVICE_NAME
    string "Advertised Device Name"
    default "Teslasynth"

config TESLASYNTH_WIFI_PASSWORD
        string "WiFi Password"
        default "Wardenclyffe1891!"
        help
            WiFi password 

config TESLASYNTH_WIFI_CHANNEL
        int "WiFi Channel"
        range 1 13
        default 1
        help
            WiFi channel (network channel)

endmenu

menu "Synth"

config CONFIG_MAX_NOTES
    int "Max notes"
    default 4
    range 1 8
    help
        This is the maximum size possible for notes.
        You can configure max concurrent notes up to this value.

config CONFIG_DEFAULT_MAX_DUTY
    int "Default max duty for all channels"
    default 10
    range 1 100
    help
        This is the maximum size possible for notes.
        You can configure max concurrent notes up to this value.
endmenu

config TESLASYNTH_GUI_ENABLED
    bool "Enable GUI support"
    default "y"

menu "GUI"
depends on TESLASYNTH_GUI_ENABLED

choice TESLASYNTH_GUI
    prompt "GUI type"
    default TESLASYNTH_GUI_NONE
    help
        Select GUI display device

    config TESLASYNTH_GUI_NONE
        bool "No GUI"

    config TESLASYNTH_GUI_STATUS_PANEL
        bool "Tiny status panel"

    config TESLASYNTH_GUI_FULL
        bool "Full GUI"
endchoice

menu "Status panel"
depends on TESLASYNTH_GUI_STATUS_PANEL

choice TESLASYNTH_DISPLAY_STATUS_PANEL
    depends on TESLASYNTH_GUI_STATUS_PANEL
    prompt "GUI display type"
    default TESLASYNTH_DISPLAY_PANEL_SSD1306_128x64
    help
        Select GUI display device

    config TESLASYNTH_DISPLAY_PANEL_SSD1306_128x64
        bool "SSD1306 128x64"

endchoice

config TESLASYNTH_DISPLAY_INTERFACE_I2C_SDA
    int "SDA Pin"
    default 21
    range 0 39

config TESLASYNTH_DISPLAY_INTERFACE_I2C_SCL
    int "SCL Pin"
    default 22
    range 0 39

config TESLASYNTH_DISPLAY_INTERFACE_I2C_RS
    int "RS Pin"
    default -1
    range -1 39

endmenu

menu "Full GUI"
depends on TESLASYNTH_GUI_FULL

choice TESLASYNTH_DISPLAY_RESOLUTION
    prompt "GUI display resolution"
    default TESLASYNTH_DISPLAY_RESOLUTION_320x240
    help
        Select GUI display resolution

    config TESLASYNTH_DISPLAY_RESOLUTION_320x240
        bool "320 x 240"
endchoice

menu "Display"

choice TESLASYNTH_DISPLAY_PANEL
    prompt "GUI display type"
    default TESLASYNTH_DISPLAY_PANEL_ILI9341
    help
        Select GUI display device

    config TESLASYNTH_DISPLAY_PANEL_ILI9341
        bool "ILI9341"

    config TESLASYNTH_DISPLAY_PANEL_ST7789
        bool "ST7789"
endchoice

config TESLASYNTH_DISPLAY_INTERFACE_SPI_CLK
    int "CLK Pin"
    default 22
    range 0 39

config TESLASYNTH_DISPLAY_INTERFACE_SPI_MOSI
    int "MOSI Pin"
    default 22
    range 0 39

config TESLASYNTH_DISPLAY_INTERFACE_SPI_MISO
    int "MISO Pin"
    default 22
    range 0 39

config TESLASYNTH_DISPLAY_INTERFACE_SPI_CS
    int "CS Pin"
    default 22
    range 0 39
    
config TESLASYNTH_DISPLAY_INTERFACE_SPI_DC
    int "DC Pin"
    default 22
    range 0 39

config TESLASYNTH_DISPLAY_INTERFACE_SPI_RS
    int "RS Pin"
    default -1
    help
      Reset pin, set to -1 if not used
    range -1 39

config TESLASYNTH_DISPLAY_BACKLIGHT_PIN
    int "Backlight Pin"
    default 2
    range 0 39

choice TESLASYNTH_DISPLAY_BACKLIGHT_LEVEL
    prompt "Backlight logic"
    default TESLASYNTH_DISPLAY_BACKLIGHT_ACTIVE_HIGH

config TESLASYNTH_DISPLAY_BACKLIGHT_ACTIVE_HIGH
    bool "Active High"

config TESLASYNTH_DISPLAY_BACKLIGHT_ACTIVE_LOW
    bool "Active Low"

endchoice

config TESLASYNTH_DISPLAY_MIRROR_X
    bool "Mirror X axis"
    
config TESLASYNTH_DISPLAY_MIRROR_Y
    bool "Mirror Y axis"

config TESLASYNTH_DISPLAY_SWAP_XY
    bool "Swap X and Y axes"

endmenu

menu "Touch"

config TESLASYNTH_TOUCH_ENABLED
    bool "Enable display touch"
    default "n"

choice TESLASYNTH_TOUCH_PANEL
    depends on TESLASYNTH_TOUCH_ENABLED
    prompt "GUI touch panel type"
    default TESLASYNTH_TOUCH_PANEL_XPT2046
    help
        Select GUI display touch panel

    config TESLASYNTH_TOUCH_PANEL_XPT2046
        bool "XPT2046"

    config TESLASYNTH_TOUCH_PANEL_STMPE610
        bool "STMPE610"
endchoice

config TESLASYNTH_TOUCH_SECONDARY_SPI
    bool "Is connected to a different SPI bus?"

menu "Secondary SPI"
depends on TESLASYNTH_TOUCH_SECONDARY_SPI
config TESLASYNTH_TOUCH_INTERFACE_SPI_CLK
    depends on TESLASYNTH_TOUCH_ENABLED
    int "CLK Pin"
    default 22
    range 0 39

config TESLASYNTH_TOUCH_INTERFACE_SPI_MOSI
    depends on TESLASYNTH_TOUCH_ENABLED
    int "MOSI Pin"
    default 22
    range 0 39

config TESLASYNTH_TOUCH_INTERFACE_SPI_MISO
    depends on TESLASYNTH_TOUCH_ENABLED
    int "MISO Pin"
    default 22
    range 0 39
endmenu

config TESLASYNTH_TOUCH_INTERFACE_SPI_CS
    depends on TESLASYNTH_TOUCH_ENABLED
    int "CS Pin"
    default 22
    range 0 39
    
config TESLASYNTH_TOUCH_INTERFACE_SPI_DC
    depends on TESLASYNTH_TOUCH_ENABLED
    int "DC Pin"
    default -1
    range -1 39

config TESLASYNTH_TOUCH_INTERFACE_SPI_RS
    depends on TESLASYNTH_TOUCH_ENABLED
    int "RS Pin"
    default -1
    help
      Reset pin, set to -1 if not used
    range -1 39

config TESLASYNTH_TOUCH_INTERFACE_SPI_IRQ
    depends on TESLASYNTH_TOUCH_ENABLED
    int "IRQ Pin"
    default -1
    help
      Reset pin, set to -1 if not used
    range -1 39

config TESLASYNTH_TOUCH_MIRROR_X
    bool "Mirror X axis"
    
config TESLASYNTH_TOUCH_MIRROR_Y
    bool "Mirror Y axis"

config TESLASYNTH_TOUCH_SWAP_XY
    bool "Swap X and Y axes"
endmenu

endmenu
    
endmenu

menu "Log"

config TESLASYNTH_DEBUG
    bool "Enable debug logs"
    default "n"
endmenu

endmenu
```
